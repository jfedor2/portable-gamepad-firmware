## app/boards/flatbox_rev10/board.yml
```yaml
board:
  name: flatbox_rev10
  full_name: Flatbox rev10
  socs:
    - name: stm32g0b1xx
```

## app/boards/flatbox_rev9/board.yml
```yaml
board:
  name: flatbox_rev9
  full_name: Flatbox rev9
  socs:
    - name: samd21e18a
```
